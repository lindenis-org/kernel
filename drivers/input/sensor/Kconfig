## drivers/input/sensor/Kconfig
```kconfig
#
# sensor driver configuration
#
menuconfig INPUT_SENSOR
	bool "Sensors"
	help
	  Say Y here, and a list of supported sensor will be displayed.
	  This option doesn't affect the kernel.

	  If unsure, say Y.

if INPUT_SENSOR
config SENSORS_GPADC
        tristate "SUNXI GPADC"
        depends on INPUT_SENSOR
        default n
        help
          If you say yes here you get support for the gpadc collect analog input

config REPEAT_KEY_USED
        bool "sunxi support key repeat"
        depends on SENSORS_GPADC
        default y
        help
          If you say yes here you get support for the repeat key.
endif
```

## drivers/input/touchscreen/ft6x/Kconfig
```kconfig
#
#  Touchscreen ft6x driver configuration
#

config TOUCHSCREEN_FT6X_TS
       tristate  "ft6x touchscreen driver"
       default m
       depends on INPUT && I2C
       help
         ft6x touchscreen driver
```

## drivers/media/platform/sunxi-vin/modules/sensor/Kconfig
```kconfig
config SENSOR_OV5640
	tristate "ov5640 sensor driver"
	default n

config SENSOR_OV2686
	tristate "ov2686 sensor driver"
	default n

config SENSOR_OV2710_AW6131
	tristate "ov2710_aw6131 sensor driver"
	default n

config SENSOR_OV2710_AW6131_CAMERA1
	tristate "ov2710_aw6131_camera1 driver"
	default n

config SENSOR_AR0238
	tristate "ar0238 sensor driver"
	default n

config SENSOR_IMX291_MIPI
	tristate "ima291_mipi sensor driver"
	default n

config SENSOR_IMX291_DVP
	tristate "imx291_dvp sensor driver"
	default n

config SENSOR_OV2718_MIPI
	tristate "ov2718_mipi sensor driver"
	default n

config SENSOR_MN34223_SLVDS
	tristate "mn34223_slvds sensor driver"
	default n

config SENSOR_IMX274_SLVDS
	tristate "imx274_slvds sensor driver"
	default n

config SENSOR_AR0238_HISPI
	tristate "ar0238_hispi sensor driver"
	default n

config SENSOR_IMX326_MIPI
	tristate "imx326_mipi sensor driver"
	default n

config SENSOR_OS08A10_MIPI
	tristate "os08a10_mipi sensor driver"
	default n

config SENSOR_OV12895_MIPI
	tristate "ov12895_mipi sensor driver"
	default n

config SENSOR_IMX477_MIPI
	tristate "imx477_mipi sensor driver"
	default n

config SENSOR_IMX385_MIPI
	tristate "imx385_mipi sensor driver"
	default n

menuconfig IMX317_PLATFORM
	bool  "imx317 platform select"
	default n

if IMX317_PLATFORM

config IPC_PLATFORM
	bool "select IPC platform config otherwise SDV platform "

config SENSOR_IMX317_MIPI
	tristate "imx317_mipi sensor driver"
	default n
endif
```
